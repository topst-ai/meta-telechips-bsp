## conf/layer.conf
```bitbake
# We have a conf and classes directory, add to BBPATH
BBPATH .= ":${LAYERDIR}"

# We have a recipes directory containing .bb and .bbappend files, add to BBFILES
BBFILES += "${LAYERDIR}/recipes-*/*/*.bb \
			${LAYERDIR}/recipes-*/*/*.bbappend"

BBFILE_COLLECTIONS += "telechips-bsp"
BBFILE_PATTERN_telechips-bsp = "^${LAYERDIR}/"
BBFILE_PRIORITY_telechips-bsp = "8"

# This should only be incremented on significant changes that will
# cause compatibility issues with other layers
LAYERVERSION_telechips-bsp = "2"

LAYERDEPENDS_telechips-bsp = "core"
include conf/meta-bsp_doc.conf

LAYERSERIES_COMPAT_telechips-bsp = "zeus dunfell"
COMPATIBLE_LICENSES_append = " ARM"
```

## conf/machine/include/arm/arch-armv8a.inc
```bitbake
TUNEVALID[arm] = "Enable ARM instruction set"
TUNEVALID[aarch32] = "Enable instructions for 32bit state for ARMv8-a (AArch32)"
TUNECONFLICTS[aarch32] = "armv4 armv5 armv6 armv7 armv7a armv7ve"

require conf/machine/include/arm/arch-arm.inc
require conf/machine/include/arm/feature-arm-neon.inc
require conf/machine/include/arm/feature-arm-vfp.inc
require conf/machine/include/arm/feature-arm-thumb.inc

TUNEVALID[crypto] = "Enable ARMv8 crypto extension."

TUNEVALID[fp-armv8] = "Enable ARMv8 Vector Floating Point unit."
TUNE_CCARGS_MFPU .= "${@bb.utils.contains('TUNE_FEATURES', 'fp-armv8', ' fp-armv8', '', d)}"
TUNE_CCARGS_MFPU .= "${@bb.utils.contains('TUNE_FEATURES', [ 'fp-armv8', 'neon' ], ' neon-fp-armv8', '', d)}"
TUNE_CCARGS_MFPU .= "${@bb.utils.contains('TUNE_FEATURES', [ 'fp-armv8', 'neon', 'crypto' ], ' crypto-neon-fp-armv8', '', d)}"

MACHINEOVERRIDES =. "${@bb.utils.contains('TUNE_FEATURES', 'aarch32', 'aarch32:', '' ,d)}"

# AArch32 Little Endian base configs
AVAILTUNES += "aarch32 aarch32t aarch32-crypto aarch32t-crypto"
ARMPKGARCH_tune-aarch32         ?= "aarch32"
ARMPKGARCH_tune-aarch32t        ?= "aarch32"
ARMPKGARCH_tune-aarch32-crypto  ?= "aarch32"
ARMPKGARCH_tune-aarch32t-crypto ?= "aarch32"
TUNE_FEATURES_tune-aarch32         = "arm aarch32 neon fp-armv8 callconvention-hard"
TUNE_FEATURES_tune-aarch32t        = "${TUNE_FEATURES_tune-aarch32} thumb"
TUNE_FEATURES_tune-aarch32-crypto  = "${TUNE_FEATURES_tune-aarch32} crypto"
TUNE_FEATURES_tune-aarch32t-crypto = "${TUNE_FEATURES_tune-aarch32-crypto} thumb"
PACKAGE_EXTRA_ARCHS_tune-aarch32         = "aarch32hf-neon-fp-armv8"
PACKAGE_EXTRA_ARCHS_tune-aarch32t        = "${PACKAGE_EXTRA_ARCHS_tune-aarch32} aarch32t2hf-neon-fp-armv8"
PACKAGE_EXTRA_ARCHS_tune-aarch32-crypto  = "${PACKAGE_EXTRA_ARCHS_tune-aarch32} aarch32hf-crypto-neon-fp-armv8"
PACKAGE_EXTRA_ARCHS_tune-aarch32t-crypto = "${PACKAGE_EXTRA_ARCHS_tune-aarch32-crypto} aarch32t2hf-crypto-neon-fp-armv8"

ARMPKGSFX_ENDIAN_64 = "${@bb.utils.contains('TUNE_FEATURES', 'bigendian', '_be', '', d)}"
TUNE_ARCH_64 = "aarch64${ARMPKGSFX_ENDIAN_64}"
TUNE_PKGARCH_64 = "aarch64${ARMPKGSFX_ENDIAN_64}"
ABIEXTENSION_64 = ""
TARGET_FPU_64 = ""

# Duplicated from arch-arm.inc
TUNE_ARCH_32 = "${@bb.utils.contains('TUNE_FEATURES', 'bigendian', 'armeb', 'arm', d)}"
TUNE_PKGARCH_32 = "${ARMPKGARCH}${ARMPKGSFX_THUMB}${ARMPKGSFX_DSP}${ARMPKGSFX_EABI}${ARMPKGSFX_ENDIAN}${ARMPKGSFX_FPU}"
ABIEXTENSION_32 = "eabi"
TARGET_FPU_32 = "${@d.getVar('TUNE_CCARGS_MFLOAT', True) or 'soft'}"

TUNE_ARCH = "${@bb.utils.contains('TUNE_FEATURES', 'aarch64', '${TUNE_ARCH_64}', '${TUNE_ARCH_32}' ,d)}"
TUNE_PKGARCH = "${@bb.utils.contains('TUNE_FEATURES', 'aarch64', '${TUNE_PKGARCH_64}', '${TUNE_PKGARCH_32}' ,d)}"
ABIEXTENSION = "${@bb.utils.contains('TUNE_FEATURES', 'aarch64', '${ABIEXTENSION_64}', '${ABIEXTENSION_32}' ,d)}"
TARGET_FPU = "${@bb.utils.contains('TUNE_FEATURES', 'aarch64', '${TARGET_FPU_64}', '${TARGET_FPU_32}' ,d)}"
```

## conf/machine/include/tune-cortexa53.inc
```bitbake
DEFAULTTUNE ?= "cortexa53"

TUNEVALID[cortexa53] = "Enable Cortex-A53 specific processor optimizations"
require conf/machine/include/arm/arch-armv8a.inc

TUNE_CCARGS .= " -mcpu=cortex-a53"
TUNE_CCARGS .= " -mtune=cortex-a53"

# AArch32 Little Endian base configs
AVAILTUNES += "cortexa53 cortexa53-crypto cortexa53-crypto"
ARMPKGARCH_tune-cortexa53        ?= "cortexa53"
ARMPKGARCH_tune-cortexa53-crypto ?= "cortexa53"
TUNE_FEATURES_tune-cortexa53         = "${TUNE_FEATURES_tune-aarch32} cortexa53"
TUNE_FEATURES_tune-cortexa53-crypto  = "${TUNE_FEATURES_tune-aarch32-crypto} cortexa53"
PACKAGE_EXTRA_ARCHS_tune-cortexa53         = "${PACKAGE_EXTRA_ARCHS_tune-aarch32} cortexa53hf-neon-fp-armv8"
PACKAGE_EXTRA_ARCHS_tune-cortexa53-crypto  = "${PACKAGE_EXTRA_ARCHS_tune-cortexa53} cortexa53hf-crypto-neon-fp-armv8"
BASE_LIB_tune-cortexa53               = "lib"
BASE_LIB_tune-cortexa53-crypto        = "lib"
```

## conf/machine/include/tune-cortexa72.inc
```bitbake
DEFAULTTUNE ?= "cortexa72"

TUNEVALID[cortexa72] = "Enable Cortex-A72 specific processor optimizations"
TUNE_CCARGS .= "${@bb.utils.contains('TUNE_FEATURES', 'cortexa72', ' -mcpu=cortex-a72', '', d)}"

require conf/machine/include/arm/arch-armv8a.inc

# AArch32 Little Endian base configs
AVAILTUNES += "cortexa72 cortexa72-crypto"
ARMPKGARCH_tune-cortexa72        ?= "cortexa72"
ARMPKGARCH_tune-cortexa72-crypto ?= "cortexa72"
TUNE_FEATURES_tune-cortexa72         = "${TUNE_FEATURES_tune-aarch32} cortexa72"
TUNE_FEATURES_tune-cortexa72-crypto  = "${TUNE_FEATURES_tune-aarch32-crypto} cortexa72"
PACKAGE_EXTRA_ARCHS_tune-cortexa72         = "${PACKAGE_EXTRA_ARCHS_tune-aarch32} cortexa72hf-neon-fp-armv8"
PACKAGE_EXTRA_ARCHS_tune-cortexa72-crypto  = "${PACKAGE_EXTRA_ARCHS_tune-cortexa72} cortexa72hf-crypto-neon-fp-armv8"
BASE_LIB_tune-cortexa72               = "lib"
BASE_LIB_tune-cortexa72-crypto        = "lib"
```

## conf/machine/tcc-family.inc
```bitbake
#@TYPE: Machine
#@NAME: Telechips SOC Family
#@DESCRIPTION: Machine configuration for the Telechips EVM Board

# Ship all kernel modules by default
MACHINE_EXTRA_RRECOMMENDS = "kernel-modules"

DEFAULT_IMAGE_FSTYPE ?= "ext4"
SWITCH_ROOTFS_MOUNT_OPT ?= "-o ro,noatime,noload"
MKUBIFS_ARGS = "--min-io-size 4096 --leb-size 516096 --max-leb-cnt 8139"

TCC_ARCH_FAMILY ?= "${@d.getVar("SOC_FAMILY").split(":")[0]}"
TCC_MACHINE_FAMILY ?= "${TCC_ARCH_FAMILY}-${@d.getVar("SOC_FAMILY").split("-")[1]}"

PREFERRED_PROVIDER_virtual/kernel = "linux-telechips"

MACHINE_FEATURES = "usbgadget usbhost vfat alsa"
MACHINE_FEATURES += "${@oe.utils.conditional('BOOT_STORAGE', 'ufs', 'ufs', 'emmc', d)}"

# This variable is used turn on usb power(vbus) in tc-enable-removable-disk_1.0.0.bb file
# You must set this variable for turn on usb power when usb media player ready
# It is name of pid(/var/run/MediaPlayer.pid) that is usb media player process
# For more information of usb power, refer to "TCCxxxx Auto.CE Common BSP-User Guide for Drivers" document
MEDIA_PLAYER_NAME ?= "TMPlayerGUI"

# initramfs -> pivot root
# default rootfs is initramfs
# If you do not want to use the initramfs,
# you have to set 'INITRAMFS_IMAGE' and 'INITRAMFS_TASK' to NULL("") on your conf/local.conf

INITRAMFS_IMAGE ?= "initramfs-telechips-image"
INITRAMFS_TASK ?= "${INITRAMFS_IMAGE}:do_image_complete"
INITRAMFS_IMAGE_BUNDLE = "1"

EXTRA_CMDLINE += "${@bb.utils.contains('INVITE_PLATFORM', 'bootchart', 'bootchart printk.time=1 initcall_debug', '', d)}"
EXTRA_CMDLINE += "${@bb.utils.contains('DISTRO_FEATURES', 'systemd', 'fsck.repair=yes', '', d)}"
CMDLINE ?= "'root=/dev/ram quiet ${EXTRA_CMDLINE}'"

KERNEL_MACH_PATH ?= "arch/arm/mach-${TCC_ARCH_FAMILY}"
TARGET_ARCH_ALIAS ?= "${TARGET_ARCH}"
TARGET_ARCH_ALIAS_aarch64 ?= "arm64"

# for fix as follow issue
# Assertion 'pthread_mutex_unlock(&m->mutex) == 0' failed at ../../pulseaudio-9.0/src/pulsecore/mutex-posix.c:108,
# function pa_mutex_unlock(). Aborting.
OLDEST_KERNEL = "4.14"

require conf/machine/include/soc-family.inc

#TARGET_CC_KERNEL_ARCH_remove = "-mno-thumb-interwork -marm"
# ddr3 type option: SK_HYNIX, WINBOND
DDR3_TYPE ??= "SK_HYNIX"
# sk hynix ddr type : H5TQ4G83AFR_PBC H5TC4G83MFR_H9A H5TQ1G83BFR_H9C H5TQ2G63BFR_H9C H5TQ2G63BFR_PBC H5TQ2G83BFR_H9C H5TQ2G83BFR_PBC
# winbond ddr type : W632GG8KB_12

DDR3_SK_HYNIX_DEFINE ??="H5TQ2G83BFR_PBC"
DDR3_WINBOND_DEFINE ??="W632GG8KB_12"

SND_CARD ??= "WM8731"

EGLFS_FB ??="fb0"
USE_SOFTAP ??= "0"
USE_VPU_ENCODER ??= "0"
MY_MAC_ADDRESS ?= "not set"
MY_IP_ADDRESS ?= "not set"
MY_GATEWAY_ADDRESS ?= "not set"
USE_KEY ??= "0"
USE_USB_TO_ETHERNET ??= "0"
USE_RNDIS_HOST ??= "0"
USE_IP_NETFILTER ??= "0"
IP_MASQUERADE_INTERFACE ??= "eth0"
IP_FORWARD_INTERFACE ??= "eth1"

INVITE_PLATFORM += "${@bb.utils.contains('EXTRA_IMAGE_FEATURES', 'ssh-server-openssh', 'network', '', d)}"

LINUX_VERSION ?= "5.4.159"
LINUXLIBCVERSION ?= "5.4"

LINUX_VERSION_EXTENSION = "-tcc"

GLIBCVERSION ?= "${@bb.utils.contains('TUNE_ARCH', 'arm', '2.32%', '2.31%', d)}"

FWDN_VERSION = "8"
DATA_PART_FSTYPE ?= "ext4"

SPLASH_IMAGE ?= "${@oe.utils.conditional('BOOT_STORAGE', 'ufs', 'splash_1920x720x32_ufs.img', 'splash_1920x720x32.img', d)}"
SPLASH_IMAGE_tcc803x = "splash_1920x720x32_tcc803xp.img"
```

## conf/machine/tcc8030-main.conf
```bitbake
#@TYPE: Machine
#@NAME: tcc8031p machine
#@DESCRIPTION: Machine configuration for the Telechips LCN Board

require tcc803x.inc

SOC_FAMILY = "tcc803x:tcc8030-main"

UBOOT_DEVICE_TREE ??= "tcc8030-evb_sv0.1"
KERNEL_DEVICETREE ??= "tcc/tcc8030-linux-lpd4321_sv0.1.dtb"

UPDATE_BOOTLOADER_NAME = "${UBOOT_NAME}.${UBOOT_SUFFIX}"
UPDATE_KERNEL_NAME = "tc-boot.img"
UPDATE_ROOTFS_NAME = "${IMAGE_LINK_NAME}.${DEFAULT_IMAGE_FSTYPE}"
UPDATE_DTB_NAME = "tcc8030-linux-lpd4321_sv0.1.dtb"
UPDATE_SNOR_NAME = "tcc803x_snor_boot.rom"

SUBCORE_DEPLOY_DIR ?= "${TOPDIR}/../tcc8030-sub/tmp/deploy/images/tcc8030-sub"
SUBCORE_BOOT_IMAGE_NAME ?= "Image-tcc8030-sub.bin"
SUBCORE_DTB_IMAGE_NAME ?= "tcc8030-linux-a7s.dtb"
SUBCORE_ROOTFS_IMAGE_NAME ?= "telechips-subcore-image-tcc8030-sub.cpio"
```

## conf/machine/tcc8034p-main.conf
```bitbake
#@TYPE: Machine
#@NAME: tcc8034p machine
#@DESCRIPTION: Machine configuration for the Telechips LCN Board

require tcc803x.inc

SOC_FAMILY = "tcc803x:tcc8034p-main"

UBOOT_DEVICE_TREE ??= "tcc803xp-evb_sv1.0"
KERNEL_DEVICETREE ??= "tcc/tcc803xpe-linux-lpd4321_sv1.0.dtb"

UPDATE_BOOTLOADER_NAME = "${UBOOT_NAME}.${UBOOT_SUFFIX}"
UPDATE_KERNEL_NAME = "tc-boot.img"
UPDATE_ROOTFS_NAME = "${IMAGE_LINK_NAME}.${DEFAULT_IMAGE_FSTYPE}"
UPDATE_DTB_NAME = "tcc803xpe-linux-lpd4321_sv1.0.dtb"
UPDATE_SNOR_NAME = "tcc803xpe_snor_boot.rom"

SUBCORE_DEPLOY_DIR ?= "${TOPDIR}/../tcc8034p-sub/tmp/deploy/images/tcc8034p-sub"
SUBCORE_BOOT_IMAGE_NAME ?= "Image-tcc8034p-sub.bin"
SUBCORE_DTB_IMAGE_NAME ?= "tcc803xpe-linux-a7s.dtb"
SUBCORE_ROOTFS_IMAGE_NAME ?= "telechips-subcore-image-tcc8034p-sub.cpio"
```

## conf/machine/tcc803x.inc
```bitbake
#@TYPE: Machine
#@NAME: Telechips TCC803x Family
#@DESCRIPTION: Machine configuration for the Telechips EVB

require conf/machine/tcc-family.inc

ARCH_INC_PATH = "${@bb.utils.contains('ARCHITECTURE', 'arm', '', '', d)}"

require ${ARCH_INC_PATH}conf/machine/include/tune-cortexa53.inc
PREFERRED_PROVIDER_virtual/kernel = "linux-telechips"

GST_ARCH_FAMILY_NAME = "TCC_803x"
LCD_TYPE ??= "TIANMA"
LCD_WIDTH ??= "1920"
LCD_HEIGHT ??= "720"
TOUCH_SCREEN_TYPE ??= ""
SND_MACHINE_MODULE_NAME ??= ""

SERIAL_CONSOLES = "115200;ttyAMA0"
KERNEL_CONSOLE = "ttyAMA0"

CONFLICT_MACHINE_FEATURES = "ufs"

EXTRA_IMAGEDEPENDS += "u-boot-tcc"
EXTRA_OMX_MACHINE_CONF = "--enable-h265dec"

UBOOT_NAME ??= "u-boot"
UBOOT_MACHINE ??= "tcc803x_defconfig"
UBOOT_MAKE_TARGET ??= "tcc803x"
UBOOT_SUFFIX ?= "rom"
UBOOT_IMAGE ?= "${UBOOT_NAME}-${MACHINE}-${PV}-${PR}.${UBOOT_SUFFIX}"
UBOOT_BINARY ?= "${UBOOT_NAME}.${UBOOT_SUFFIX}"
UBOOT_SYMLINK ?= "${UBOOT_NAME}-${MACHINE}.${UBOOT_SUFFIX}"

KBUILD_DEFCONFIG ??= "tcc803x_linux_ivi_defconfig"

KERNEL_BASE_ADDR = "0x20000000"

SND_CARD ??= "AK4601"

INVITE_PLATFORM += "telechips-egl"

PREFERRED_PROVIDER_virtual/egl			= "telechips-egl"
PREFERRED_PROVIDER_virtual/libgles1		= "telechips-egl"
PREFERRED_PROVIDER_virtual/libgles2		= "telechips-egl"
PREFERRED_PROVIDER_virtual/mesa			= "telechips-egl"
PREFERRED_PROVIDER_libglapi				= "telechips-egl"
PREFERRED_PROVIDER_libgbm				= "telechips-egl"
PREFERRED_PROVIDER_libwayland-egl		= "telechips-egl"
```

## conf/machine/tcc8050-main.conf
```bitbake
#@TYPE: Machine
#@NAME: tcc8050 machine
#@DESCRIPTION: Machine configuration for the Telechips LCN Board

require tcc805x.inc

SOC_FAMILY = "tcc805x:tcc8050-main"

GPU_DRIVER_MODE ??= "${@bb.utils.contains_any("INVITE_PLATFORM", 'gpu-vz', 'guest', 'native', d)}"

UBOOT_MACHINE ?= "${@oe.utils.conditional('BOOT_STORAGE', 'ufs', 'tcc805x_ufs_defconfig', 'tcc805x_defconfig', d)}"
KBUILD_DEFCONFIG ?= "${@oe.utils.conditional('BOOT_STORAGE', 'ufs', 'tcc805x_linux_ivi_ufs_defconfig', 'tcc805x_linux_ivi_defconfig', d)}"
KERNEL_DEVICETREE ?= "tcc/tcc8050-linux-ivi-tost_sv0.1.dtb"
KERNEL_BASE_ADDR = "0x20000000"

UBOOT_NAME = "ca72_bl3"
UBOOT_DEVICE_TREE = "tcc8050-ivi-tost_sv0.1"

UBOOT_SUFFIX = "rom"
UBOOT_IMAGE = "${UBOOT_NAME}-${MACHINE}-${PV}-${PR}.${UBOOT_SUFFIX}"
UBOOT_BINARY = "${UBOOT_NAME}.${UBOOT_SUFFIX}"
UBOOT_SYMLINK = "${UBOOT_NAME}-${MACHINE}.${UBOOT_SUFFIX}"

UPDATE_BOOTLOADER_NAME = "${UBOOT_NAME}.${UBOOT_SUFFIX}"
UPDATE_KERNEL_NAME = "tc-boot-${MACHINE}.img"
UPDATE_ROOTFS_NAME = "${IMAGE_LINK_NAME}.${DEFAULT_IMAGE_FSTYPE}"
UPDATE_DTB_NAME = "tcc8050-linux-ivi-tost_sv0.1.dtb"
UPDATE_SNOR_NAME = "${CHIP_NAME}_snor.cs.rom"

SUBCORE_DEPLOY_DIR ?= "${TOPDIR}/../tcc8050-sub/tmp/deploy/images/tcc8050-sub"
SUBCORE_BOOT_IMAGE_NAME ?= "tc-boot-tcc8050-sub.img"
SUBCORE_DTB_IMAGE_NAME ?= "tcc8050-linux-subcore-ivi-tost_sv0.1.dtb"
SUBCORE_ROOTFS_IMAGE_NAME ?= "telechips-subcore-image-tcc8050-sub.ext4"
```

## conf/machine/tcc8053-main.conf
```bitbake
#@TYPE: Machine
#@NAME: tcc8053 machine
#@DESCRIPTION: Machine configuration for the Telechips LCN Board

require tcc805x.inc

SOC_FAMILY = "tcc805x:tcc8053-main"

GPU_DRIVER_MODE ??= "${@bb.utils.contains_any("INVITE_PLATFORM", 'gpu-vz', 'guest', 'native', d)}"

UBOOT_MACHINE ?= "${@oe.utils.conditional('BOOT_STORAGE', 'ufs', 'tcc805x_ufs_defconfig', 'tcc805x_defconfig', d)}"
KBUILD_DEFCONFIG ?= "${@oe.utils.conditional('BOOT_STORAGE', 'ufs', 'tcc805x_linux_ivi_ufs_defconfig', 'tcc805x_linux_ivi_defconfig', d)}"
KERNEL_DEVICETREE ?= "tcc/tcc8053-linux-lpd4x322_sv1.0.dtb"
KERNEL_BASE_ADDR = "0x20000000"

UBOOT_NAME = "ca72_bl3"
UBOOT_DEVICE_TREE = "tcc8053-evb_sv1.0"

UBOOT_SUFFIX = "rom"
UBOOT_IMAGE = "${UBOOT_NAME}-${MACHINE}-${PV}-${PR}.${UBOOT_SUFFIX}"
UBOOT_BINARY = "${UBOOT_NAME}.${UBOOT_SUFFIX}"
UBOOT_SYMLINK = "${UBOOT_NAME}-${MACHINE}.${UBOOT_SUFFIX}"

UPDATE_BOOTLOADER_NAME = "${UBOOT_NAME}.${UBOOT_SUFFIX}"
UPDATE_KERNEL_NAME = "tc-boot-${MACHINE}.img"
UPDATE_ROOTFS_NAME = "${IMAGE_LINK_NAME}.${DEFAULT_IMAGE_FSTYPE}"
UPDATE_DTB_NAME = "tcc8053-linux-lpd4x322_sv1.0.dtb"
UPDATE_SNOR_NAME = "${CHIP_NAME}_snor.cs.rom"

SUBCORE_DEPLOY_DIR ?= "${TOPDIR}/../tcc8053-sub/tmp/deploy/images/tcc8053-sub"
SUBCORE_BOOT_IMAGE_NAME ?= "tc-boot-tcc8053-sub.img"
SUBCORE_DTB_IMAGE_NAME ?= "tcc8053-linux-subcore_sv1.0.dtb"
SUBCORE_ROOTFS_IMAGE_NAME ?= "telechips-subcore-image-tcc8053-sub.ext4"
```
