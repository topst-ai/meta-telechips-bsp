## conf/machine/tcc8059-main.conf
```bitbake
#@TYPE: Machine
#@NAME: tcc8059 machine
#@DESCRIPTION: Machine configuration for the Telechips LCN Board

require tcc805x.inc

SOC_FAMILY = "tcc805x:tcc8059-main"

GPU_DRIVER_MODE ??= "${@bb.utils.contains_any("INVITE_PLATFORM", 'gpu-vz', 'guest', 'native', d)}"

UBOOT_MACHINE ?= "tcc805x_defconfig"
KBUILD_DEFCONFIG ?= "tcc805x_linux_ivi_defconfig"
KERNEL_DEVICETREE ?= "tcc/tcc8059-linux-lpd4x321_sv0.1.dtb"
KERNEL_BASE_ADDR = "0x20000000"

CONFLICT_MACHINE_FEATURES = "ufs"

UBOOT_NAME = "ca72_bl3"
UBOOT_DEVICE_TREE = "tcc8059-evb_sv0.1"

UBOOT_SUFFIX = "rom"
UBOOT_IMAGE = "${UBOOT_NAME}-${MACHINE}-${PV}-${PR}.${UBOOT_SUFFIX}"
UBOOT_BINARY = "${UBOOT_NAME}.${UBOOT_SUFFIX}"
UBOOT_SYMLINK = "${UBOOT_NAME}-${MACHINE}.${UBOOT_SUFFIX}"

UPDATE_BOOTLOADER_NAME = "${UBOOT_NAME}.${UBOOT_SUFFIX}"
UPDATE_KERNEL_NAME = "tc-boot-${MACHINE}.img"
UPDATE_ROOTFS_NAME = "${IMAGE_LINK_NAME}.${DEFAULT_IMAGE_FSTYPE}"
UPDATE_DTB_NAME = "tcc8059-linux-lpd4x321_sv0.1.dtb"
UPDATE_SNOR_NAME = "${CHIP_NAME}_snor.cs.rom"

SUBCORE_DEPLOY_DIR ?= "${TOPDIR}/../tcc8059-sub/tmp/deploy/images/tcc8059-sub"
SUBCORE_BOOT_IMAGE_NAME ?= "tc-boot-tcc8059-sub.img"
SUBCORE_DTB_IMAGE_NAME ?= "tcc8059-linux-subcore_sv0.1.dtb"
SUBCORE_ROOTFS_IMAGE_NAME ?= "telechips-subcore-image-tcc8059-sub.ext4"
```

## conf/machine/tcc805x.inc
```bitbake
#@TYPE: Machine
#@NAME: Telechips TCC805x Family
#@DESCRIPTION: Machine configuration for the Telechips EVM Board

require conf/machine/tcc-family.inc
require conf/machine/include/tune-cortexa72.inc
PREFERRED_PROVIDER_virtual/kernel = "linux-telechips"

GST_ARCH_FAMILY_NAME = "TCC_805x"
LCD_TYPE ??= "TIANMA"
LCD_WIDTH ??= "1920"
LCD_HEIGHT ??= "720"
TOUCH_SCREEN_TYPE ??= ""
SND_MACHINE_MODULE_NAME ??= ""

BOOT_STORAGE ??= "emmc"
SERIAL_CONSOLES = "115200;ttyAMA0"
KERNEL_CONSOLE = "ttyAMA0"
# set linux-kernel and linux-libc-headers version

EXTRA_IMAGEDEPENDS += "u-boot-tcc"
EXTRA_OMX_MACHINE_CONF = "--enable-h265dec"

UBOOT_MACHINE ??= "tcc805x_defconfig"
UBOOT_MAKE_TARGET = "tcc805x"

SND_CARD ??= "AK4601"

SUBCORE_BOOT_LOADER_NAME ?= "ca53_bl3.rom"
```
